/*
 * ReaXtrobe - An Open-Source Pitch-Reactive Addressable RGB LED Controller
 * This code has been heavily modified and re-organized from some code
 * Pete Reiter made, "Spectrum analyzer". That code was itself taken
 * from an Adafruit sketch for the PICCOLO. I have added much scaling,
 * tweaking, smoothing, etc to make this a good stationary music and
 * sound reactive decoration.
 * 
 * Software needed:
 * - FHT library (working version included in "libraries")
 * - Adafruit Neopixel library (available through the Library Manager)
 * 
 * Hardware needed:
 * - Arduino Nano
 * - MAX9814 microphone module, OUT to A0
 * - 2x WS2812 circuar 16 led rings chained together, data on pin 2
 * - A 5V power supply with a bit of power capability, maybe >500mA
 */

////INCLUDES////
#include <avr/pgmspace.h>
#define FHT_N 256
#define LIN_OUT 1
#include <FHT.h>
#include <Adafruit_NeoPixel.h>

/****BEGIN USER EDITABLE SECTION****/

////HARDWARE DEFINES////
#define LED_PIN 2 // digital pin for programming neopixels, default = 2
#define GAIN_PIN 3 // tristate pin for setting the gain, default = 3
#define NUM_PIXELS 32 // number of lights, default = 32 (2x16)

////ROTATION DEFINES////
#define OFFSET_1 0 // rotation offset on first neopixel ring
#define OFFSET_2 8 // rotation offset on second neopixel ring

////AUDIO DEFINES////
#define GAIN 50 // The maximum mic gain for AGC, can be 40dB, 50dB, or 60dB, default = 50

////BEHAVIOR DEFINES////
#define SPACING_FACTOR 8.0 //Used to make bass larger.
#define GAIN_FACTOR 3 //higher means lower output values, a >> operation
#define OFF_THRESH 0 //higher clips lower amplitudes more
#define DECAY 50 //temporal decay. 0-255, lower is slower changing
#define IGNORE_TOP_BINS 50 //how many upper bins to ignore, higher = lower cuttoff = more bass

/****END USER EDITABLE SECTION****/

////ADJUSTMENT MATRICIES////
static const uint8_t PROGMEM
  // This is low-level noise that's subtracted from each FHT output column
  // This was experimentally determined in a quiet room.
  noise[128]={ 
    50, 12, 10, 8, 7, 6, 6, 5, // 0
    5, 5, 4, 4, 4, 4, 4, 4,    // 8
    4, 4, 4, 4, 4, 4, 4, 4,    // 16
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    3, 3, 3, 3, 3, 3, 3, 3     // 120
};
static const uint8_t PROGMEM
  calibration[128] = {
    1, 1, 1, 1, 1, 1, 1, 1, 
    1, 1, 1, 1, 1, 1, 1, 1, 
    1, 1, 1, 1, 1, 1, 1, 1, 
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    3, 3, 3, 3, 3, 3, 3, 3  
  } ;
  // This is the mapping from the values in the buckets to the colors
  //representing those values. These numbers were generated by some C
  //code that I've pasted into the bottom of this
  // file. The colors go from off->blue->green->red with an increase in
  //intensity as the values increase. There's also a log10 based
  //response curve figured in.
  #define NUM_COLORS 256
  static const uint32_t PROGMEM colors[NUM_COLORS] = { 
    0x0, 0x17, 0x2b, 0x3d, 0x4d, 0x5c, 0x55f, 0xc5c, 0x1458,
    0x1b55, 0x2252, 0x294f, 0x2f4c, 0x3648, 0x3c45, 0x4242,
    0x473f, 0x4d3b, 0x5238, 0x5735, 0x5d32, 0x612f, 0x662c,
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    0xfe0200, 0xfe0100, 0xff0100
    }; 

////MISC DECLARATION////
Adafruit_NeoPixel strip = Adafruit_NeoPixel(NUM_PIXELS, LED_PIN, NEO_GRB + NEO_KHZ800);
int num_bins = (FHT_N/2) - 2 - IGNORE_TOP_BINS;
int bins_per_group[NUM_PIXELS / 2];
int avg_val[NUM_PIXELS / 2];
int pos;
volatile uint32_t samplePos = 0;     // Buffer position counter

////SETUP////
void setup() {
  Serial.begin(9600); //IDK why but it won't work unless I do this
  
  memset(avg_val,0,sizeof(avg_val)); //set all to 0, the cheeky way ;)
  
  //calc number of bins for each group
  float weights[NUM_PIXELS / 2];
  for(int g = 0; g < NUM_PIXELS / 2; g++)
  {
    //calc bins per group weight
    weights[g] = pow((float)g, SPACING_FACTOR) + 1;
  }
  float weight_sum = 0;
  for(int g = 0; g < NUM_PIXELS / 2; g++)
  {
    weight_sum += weights[g];
  }
  for(int g = 0; g < NUM_PIXELS / 2; g++)
  {
    float percent = weights[g] / weight_sum;
    float bins = (float)num_bins * percent;
    bins = round(bins);
    if((int)bins > 0)
    {
      bins_per_group[g] = (int)bins;
    }
    else
    {
      bins_per_group[g] = 1;
    }
  }
  
  // FHT setup (may be Nano specific?)
  TIMSK0 = 0; // turn off timer0 for lower jitter
  ADCSRA = 0xe5; // set the adc to free running mode
  ADMUX = 0x40; // use adc0
  DIDR0 = 0x01; // turn off the digital input for adc0

  // Neopixels setup
  // Initialize all pixels to 'off'
  strip.setBrightness(255);
  strip.begin(); // Initialize all pixels to 'off'
  cli();         // disable interrupts when writing neopixels   
  strip.show();
  sei();         // Enable interrupts

  // Set MAX9814 maximum gain
  switch(GAIN)
  {
    case 40: // set to 40dB
      // set pin to high
      pinMode(GAIN_PIN, OUTPUT);
      digitalWrite(GAIN_PIN, HIGH);
      break;
    case 60: // set to 60dB
      // set pin to floating
      digitalWrite(GAIN_PIN, LOW);
      pinMode(GAIN_PIN, INPUT);
      break;
    default: // set to 50dB
    // set pin to low
      pinMode(GAIN_PIN, OUTPUT);
      digitalWrite(GAIN_PIN, LOW);
  }
}

////LOOP////
void loop() {
  uint16_t  x, L;
  while(ADCSRA & _BV(ADIE)); // Wait for audio sampling to finish

  fht_window();
  fht_reorder();
  fht_run();
  fht_mag_lin();
  samplePos = 0;                   // Reset sample counter
  ADCSRA |= _BV(ADIE);             // Resume sampling interrupt

  // Remove noise
  for(x=0; x<FHT_N/2; x++) {
    L = (pgm_read_byte(&noise[x]) << 6);
    fht_lin_out[x] = (fht_lin_out[x] <= L) ? 0 : (fht_lin_out[x] - L);
  }
  
  int bin = 0;
  for (int i = 0; i < NUM_PIXELS / 2; i++)
  {
      int value = 0;
      int curr_val;
      for (int j = 0; j < bins_per_group[i]; j++)
      {
        curr_val = fht_lin_out[bin + 2];
        if(value < curr_val) {
          value = curr_val;
        }
        if(bin + 2 < num_bins)
        {
          bin ++;
        }
      }
      
      value >>= GAIN_FACTOR;
      if (value < OFF_THRESH)
        value = 0;
      if (value >= NUM_COLORS)
        value = NUM_COLORS - 1;  

      if(value > avg_val[i]) {
        avg_val[i] = value;
      }
      else {
        avg_val[i] -= DECAY;
      }
      if(avg_val[i] < 0) {
        avg_val[i] = 0;
      }
  }

  //I would have saved time by doing this in the loop above, but one of
  //the setPixelColor commands was ignored if done out-of-order like
  //below. Bah, the framerate is fine anyway.
  for(int i = 0; i < NUM_PIXELS; i++) {
    if(i >= NUM_PIXELS / 2) {
      
      pos = ((NUM_PIXELS / 2) - 1) - ((i + OFFSET_1) % (NUM_PIXELS/2));
    }
    else {
      pos = (i + OFFSET_2) % (NUM_PIXELS/2);
    }
    strip.setPixelColor(i, pgm_read_dword(&colors[avg_val[pos]]));
  }
  
  cli();        // no interrupts while writing the neopixels
  strip.show();
  sei();        // restore interrupts
}

// interrupt service routine. This gets called each time the ADC finishes 1 sample.
ISR(ADC_vect) { // Audio-sampling interrupt
  // shift the unsigned input to be centered around 0. The 10-bit ADC is 
  // capable of producing values from 0 - 1023, but with a microphone that outputs
  // 2V max and a reference voltage of 3.3V we will never hit the max.
  fht_input[samplePos] = (ADC - 512) << 6;
//  Serial.println(fht_input[samplePos]);
  if(++samplePos >= FHT_N) ADCSRA &= ~_BV(ADIE); // Buffer full, interrupt off
}

/*
// Some C code I used to generate the values->colors map. I didn't run this code on the Arduino. I used ideone.com
// and then pasted the output into my arduino code.
#include <iostream>
#include <stdint.h>
#include <math.h>
using namespace std;
  
const int numValues = 256; // number of colors in our output array. This should correspond 
                          // to the max value you want to display.

double breakPoint = log10(numValues)/3.0;
//double breakPoint = numValues/4.0;
//
// Blend two colors together based on the ratio. ratio of 0.0 will be 100% color a and
// ratio of 1.0 will be 100% color b.
uint32_t blend (uint32_t ina, uint32_t inb, double ratio)
{
  int r = (((ina >> 16) & 0xff) * (1.0-ratio)) + (((inb >> 16) & 0xff) * ratio);
  int g = (((ina >> 8) & 0xff) * (1.0-ratio)) + (((inb >> 8) & 0xff) * ratio);
  int b = (((ina >> 0) & 0xff) * (1.0-ratio)) + (((inb >> 0) & 0xff) * ratio);
  return ((r << 16) | (g << 8) | b);
}
//
// Scale the intensity of the passed in color. I am using max brightness colors and 
// 0.0 - 1.0 as the scale value.
uint32_t scale (uint32_t ina, double scale_value)
{
  int r = ((ina >> 16) & 0xff) * scale_value;
  int g = ((ina >> 8) & 0xff) * scale_value;
  int b = ((ina >> 0) & 0xff) * scale_value;
  return ((r << 16) | (g << 8) | b);  
}
//  
// Fade off -> blue -> green -> red. I've built in a logarithmic response to make it more of a
// dB meter.
int main() { 
  for (int i = 1; i <= numValues; i++)
  {
    double logValue = log10(i);
    double scaleValue = log10(i+2) / log10(numValues+2);
    //double logValue = i;
    //double scaleValue = i+2 / numValues+2;
    double ratio = (logValue < breakPoint) ? logValue / breakPoint : (logValue - breakPoint) / breakPoint;
    uint32_t color = 0;
    if (logValue < breakPoint)
      color = blend (0x000000, 0x00ff, ratio);
    else if (logValue < breakPoint * 2)
      color = blend (0x0000ff, 0x00ff00, ratio);
    else
      color = blend (0x00ff00, 0xff0000, ratio);
    color = scale (color, scaleValue);
    cout <<  "0x" << hex << color << ", ";
  }
  return 0; 
}
*/
